## main/Kconfig.projbuild
```kconfig
menu "Hardware Configuration"

    config APP_LED_CONTROL
        bool "Enable LED Control (WS2812B)"
        default n
        help
            Enable support for WS2812B LED control (Web UI & RainMaker).
            If disabled, LED driver and related APIs will not be compiled.

    config APP_LED_GPIO
        int "LED GPIO"
        default 2
        help
            GPIO number for the RGB LED (WS2812B).

    config APP_BUTTON_GPIO
        int "Button GPIO"
        default 3
        help
            GPIO number for the onboard button.

    config APP_BUTTON_ACTIVE_LEVEL
        int "Button Active Level"
        default 0
        range 0 1
        help
            0: Active Low, 1: Active High.

    config APP_IR_TX_GPIO
        int "IR Transmitter GPIO"
        default 8
        help
            GPIO number for the IR Transmitter LED.

    config APP_IR_RX_GPIO
        int "IR Receiver GPIO"
        default 9
        help
            GPIO number for the IR Receiver Module.

endmenu


menu "Sensors"

    config GOKU_SENSOR_AHT20
        bool "Enable AHT20 Temperature & Humidity Sensor"
        default n
        help
            Enable support for AHT20 sensor.
            Adds sensor readings to RainMaker, HomeKit, and Web UI.
            Requires I2C connection.

    config APP_I2C_SDA
        int "I2C SDA GPIO"
        default 6
        depends on GOKU_SENSOR_AHT20
        help
            GPIO number for I2C SDA line.

    config APP_I2C_SCL
        int "I2C SCL GPIO"
        default 5
        depends on GOKU_SENSOR_AHT20
        help
            GPIO number for I2C SCL line.

endmenu

menu "Mobile Platform"

    choice GOKU_MOBILE_PLATFORM
        prompt "Platform Selection"
        default GOKU_PLATFORM_ANDROID
        help
            Select the target mobile platform ecosystem.
            This selection is MUTUALLY EXCLUSIVE.

        config GOKU_PLATFORM_ANDROID
            bool "Android (ESP RainMaker)"
            select ESP_RAINMAKER_ENABLE     # Virtual logic flag if needed
            help
                Build for Android. Enables ESP RainMaker cloud provisioning
                and control. Disables HomeKit.

        config GOKU_PLATFORM_IOS
            bool "iOS (Apple HomeKit)"
            help
                Build for iOS. Enables Apple HomeKit Accessory integration.
                Disables RainMaker.
    endchoice

endmenu

menu "WiFi Configuration"

    choice APP_PROV_TRANSPORT_METHOD
        prompt "Provisioning Transport Method"
        default APP_WIFI_PROV_TRANSPORT_SOFTAP
        help
            Select the transport method for Wi-Fi provisioning.

        config APP_WIFI_PROV_TRANSPORT_SOFTAP
            bool "SoftAP"
            help
                Use SoftAP for provisioning.

        config APP_WIFI_PROV_TRANSPORT_BLE
            bool "BLE"
            help
                Use BLE for provisioning (requires Bluetooth enabled in sdkconfig).
    endchoice

    config APP_PROV_SERVICE_NAME
        string "Provisioning Service Name"
        default "PROV_GOKU_IR"
        help
            Name of the BLE/SoftAP provisioning service.

    config APP_PROV_POP
        string "Proof of Possession (PoP)"
        default "12345678"
        help
            Password for provisioning.

    config APP_WIFI_FALLBACK_SSID
        string "Fallback AP SSID"
        default "Goku-Recovery"
        help
            SSID for the fallback Access Point.

    config APP_WIFI_FALLBACK_PASSWORD
        string "Fallback AP Password"
        default "12345678"
        help
            Password for the fallback Access Point. Leave empty for Open.

endmenu

menu "OTA Configuration"

    config OTA_SERVER_URL
        string "OTA Server URL"
        default "https://salty-mouth.surge.sh"
        help
            Base URL for the OTA server (e.g. https://tunnel.trycloudflare.com).
            The device will look for version.txt and goku-ir-device.bin at this URL.

    config OTA_CHECK_INTERVAL
        int "OTA Check Interval (seconds)"
        default 3600
        help
            How often to check for updates in seconds.

endmenu

menu "iOS WiFi Provisioning"
    depends on GOKU_PLATFORM_IOS
    
    config IOS_WIFI_PROV_AP_ENABLE
        bool "Enable SoftAP WiFi Provisioning for iOS"
        default y
        help
            Enable captive portal provisioning via SoftAP for iOS devices.
            When enabled, device will start a temporary WiFi Access Point
            on first boot or when no WiFi credentials are stored.
            
    config IOS_WIFI_AP_SSID_PREFIX
        string "SoftAP SSID Prefix"
        default "Goku-Setup"
        depends on IOS_WIFI_PROV_AP_ENABLE
        help
            Prefix for the temporary WiFi AP name.
            Full SSID will be: PREFIX-MACADDR (e.g., Goku-Setup-ABCD)
            
    config IOS_WIFI_AP_PASSWORD
        string "SoftAP Password (leave empty for open network)"
        default ""
        depends on IOS_WIFI_PROV_AP_ENABLE
        help
            Password for the temporary WiFi AP.
            Leave empty for an open network (recommended for easy setup).
            
    config IOS_WIFI_AP_CHANNEL
        int "SoftAP WiFi Channel"
        default 1
        range 1 13
        depends on IOS_WIFI_PROV_AP_ENABLE
        help
            WiFi channel for the temporary AP (1-13).
            
    config IOS_WIFI_AP_MAX_CONNECTIONS
        int "Maximum SoftAP Connections"
        default 4
        range 1 10
        depends on IOS_WIFI_PROV_AP_ENABLE
        help
            Maximum number of devices that can connect to the AP simultaneously.

endmenu
```

## sdkconfig.defaults
```kconfig
CONFIG_ESPTOOLPY_FLASHSIZE_4MB=y
CONFIG_FREERTOS_TIMER_TASK_STACK_DEPTH=4096
CONFIG_ESP_RMAKER_MAX_PARAM_DATA_SIZE=4096
CONFIG_ESP_RMAKER_WORK_QUEUE_TASK_STACK=8192
CONFIG_PARTITION_TABLE_CUSTOM=y
CONFIG_PARTITION_TABLE_CUSTOM_FILENAME="partitions.csv"
CONFIG_ESP_RMAKER_ENABLE_CHALLENGE_RESPONSE=n
# Increase HTTP Client Buffer to handle long S3 URLs
CONFIG_ESP_HTTP_CLIENT_BUFFER_SIZE=4096
CONFIG_ESP_HTTP_CLIENT_BUFFER_SIZE_TX=4096

# BLE Provisioning Support
CONFIG_BT_ENABLED=y
CONFIG_BT_NIMBLE_ENABLED=y
CONFIG_ESP_WIFI_PROV_TRANSPORT_BLE=y

# Increase HTTP server header limits to fix "Header fields are too long"
CONFIG_HTTPD_MAX_REQ_HDR_LEN=1024
CONFIG_HTTPD_MAX_URI_LEN=1024

# Optimization for TLS (Saves heap)
CONFIG_MBEDTLS_DYNAMIC_BUFFER=y
CONFIG_MBEDTLS_DYNAMIC_FREE_CONFIG_DATA=y
CONFIG_MBEDTLS_DYNAMIC_FREE_CA_CERT=y

# Increase default stacks for network tasks
CONFIG_ESP_MAIN_TASK_STACK_SIZE=8192
CONFIG_PTHREAD_TASK_STACK_SIZE_DEFAULT=8192

# Enable OTA Rollback
CONFIG_BOOTLOADER_APP_ROLLBACK_ENABLE=y

# Allow OTA without certificate verification (for memory-constrained devices)
# WARNING: This is insecure and should only be used for testing or trusted networks
CONFIG_ESP_HTTPS_OTA_ALLOW_HTTP=y
CONFIG_ESP_TLS_INSECURE=y
CONFIG_ESP_TLS_SKIP_SERVER_CERT_VERIFY=y
```

## sdkconfig.defaults.esp32c3
```kconfig
# ESP32-C3 Configuration
CONFIG_BT_ENABLED=y
CONFIG_BT_NIMBLE_ENABLED=y
CONFIG_ESP_WIFI_PROV_TRANSPORT_BLE=y
CONFIG_APP_WIFI_PROV_TRANSPORT_BLE=y
CONFIG_APP_WIFI_PROV_TRANSPORT_SOFTAP=n
```

## sdkconfig.defaults.esp32s3
```kconfig
# PSRAM Configuration for ESP32-S3 SuperMini (2MB)
CONFIG_SPIRAM=y
CONFIG_SPIRAM_MODE_QUAD=y
CONFIG_SPIRAM_TYPE_AUTO=y
CONFIG_SPIRAM_SPEED_80M=y
CONFIG_SPIRAM_BOOT_INIT=y
CONFIG_SPIRAM_USE_MALLOC=y
CONFIG_SPIRAM_MALLOC_RESERVE_INTERNAL=32768
CONFIG_SPIRAM_MALLOC_ALWAYSINTERNAL=16384
CONFIG_SPIRAM_TRY_ALLOCATE_WIFI_LWIP=y
CONFIG_SPIRAM_MEMTEST=y
```
